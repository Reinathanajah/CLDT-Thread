## firmware/endpoint/main/Kconfig.projbuild
```kconfig
menu "CLDT Endpoint"

config CLDT_ENDPOINT_NODE_ID
    int "Provisioning fallback node ID"
    range 1 4294967295
    default 100
    help
        Used only before the endpoint receives a provisioned identity. Record the
        final identity in run evidence; do not use a MAC address or an ad hoc hash.

choice CLDT_ENDPOINT_ROLE
    prompt "Endpoint role"
    default CLDT_ENDPOINT_ROUTER

config CLDT_ENDPOINT_ROUTER
    bool "Router-capable endpoint"
    help
        Enables the project role expected to be router-capable. Actual Thread role
        remains an observed run fact and must not be inferred from this selection.

config CLDT_ENDPOINT_LOW_POWER
    bool "Low-power end-device candidate"
    help
        Selects a candidate end-device configuration for a later admitted study.
        Actual Thread role remains observed, and no version-one energy claim is
        implied by this build choice.

endchoice

config CLDT_ENDPOINT_POOL_SLOTS
    int "Fixed message slots"
    range 8 128
    default 32
    help
        Compile-time queue-pool capacity. Choose from measured peak occupancy and
        preserve a control/critical reservation; never grow it only to hide loss.

config CLDT_ENDPOINT_MAX_TOTAL_RATE_PPS
    int "Compiled maximum aggregate application rate"
    range 1 500
    default 100
    help
        Hard local ceiling across all application streams. A ready manifest may
        request less, but no host policy can raise this value during a run.

config CLDT_ENDPOINT_EVENT_GPIO
    int "Local event input GPIO"
    range -1 30
    default -1
    help
        -1 disables the optional physical event input. Select a pin only after
        checking the exact board revision, boot strapping, pull mode, and debounce
        behavior; XIAO GPIO9 is a boot input and is not a safe generic default.

config CLDT_ENDPOINT_I2C_SDA_GPIO
    int "Optional power-probe I2C SDA GPIO"
    range 0 30
    default 22
    help
        XIAO ESP32-C6 D4/SDA is GPIO22. The version-one power probe is deferred;
        recheck the exact board and record wiring before a future energy pilot.

config CLDT_ENDPOINT_I2C_SCL_GPIO
    int "Optional power-probe I2C SCL GPIO"
    range 0 30
    default 23
    help
        XIAO ESP32-C6 D5/SCL is GPIO23. Do not assume another C6 board variant
        shares this mapping.

endmenu
```

## firmware/endpoint/sdkconfig.defaults
```kconfig
CONFIG_FREERTOS_HZ=1000
CONFIG_FREERTOS_USE_TRACE_FACILITY=y
CONFIG_FREERTOS_GENERATE_RUN_TIME_STATS=y
CONFIG_ESP_TASK_WDT_EN=y
CONFIG_OPENTHREAD_ENABLED=y
CONFIG_MBEDTLS_CHACHAPOLY_C=y
CONFIG_MBEDTLS_CHACHA20_C=y
CONFIG_MBEDTLS_POLY1305_C=y
```

## firmware/gateway/main/Kconfig.projbuild
```kconfig
menu "CLDT Gateway"

config CLDT_GATEWAY_NODE_ID
    int "Provisioning fallback node ID"
    range 1 4294967295
    default 1
    help
        Used only before a provisioned identity is present in NVS.

config CLDT_GATEWAY_RX_QUEUE_LENGTH
    int "Thread receive queue slots"
    range 4 128
    default 32
    help
        Bounded slots between Thread receive and aggregation. Select using peak
        observed arrival rate and consumer service time, then trace high-water.

config CLDT_GATEWAY_TRACE_QUEUE_LENGTH
    int "Observation queue slots"
    range 16 512
    default 128
    help
        Bounded observation queue. Overflow must become a visible health event;
        this setting is not permission to retain arbitrary broker backlog.

config CLDT_GATEWAY_MAX_TOTAL_RATE_PPS
    int "Compiled maximum aggregate application rate"
    range 1 500
    default 100
    help
        Compiled aggregate ceiling enforced by the edge guard. It is independent
        of host prediction and remains active during a host or broker failure.

config CLDT_GATEWAY_MAX_POLICY_TTL_MS
    int "Compiled maximum policy lifetime"
    range 1000 60000
    default 10000
    help
        Longest acceptable remote-policy lifetime. A control_profile may request
        a shorter TTL but cannot extend a command beyond this local bound.

config CLDT_GATEWAY_REMOTE_ACTUATION
    bool "Compile candidate remote-actuation path"
    default n
    help
        Keep disabled during testbed and shadow-model work. Enabling this switch
        does not bypass ready-manifest, authentication, run/epoch, TTL, local
        health, edge-limit, fallback, or endpoint validation requirements.

config CLDT_GATEWAY_RCP_UART_RX_GPIO
    int "RCP UART receive GPIO"
    range 0 48
    default 18
    help
        Gateway receive pin connected to the RCP transmit pin. Verify crossover,
        voltage compatibility, and the selected RCP UART configuration together.

config CLDT_GATEWAY_RCP_UART_TX_GPIO
    int "RCP UART transmit GPIO"
    range 0 48
    default 17
    help
        Gateway transmit pin connected to the RCP receive pin. Record final
        wiring, baud rate, and reset behavior in the upstream bring-up evidence.

config CLDT_GATEWAY_RCP_RESET_GPIO
    int "RCP reset GPIO"
    range -1 48
    default -1
    help
        -1 leaves optional RCP reset control disabled. Select a free S3 GPIO only
        after the C6 EN electrical behavior and wiring have been verified.

config CLDT_GATEWAY_RCP_BOOT_GPIO
    int "RCP boot GPIO"
    range -1 48
    default -1
    help
        -1 leaves optional RCP boot-mode control disabled. Treat any enabled
        value as board-specific wiring and validate it before automated reset.

endmenu
```

## firmware/gateway/sdkconfig.defaults
```kconfig
CONFIG_FREERTOS_HZ=1000
CONFIG_FREERTOS_USE_TRACE_FACILITY=y
CONFIG_FREERTOS_GENERATE_RUN_TIME_STATS=y
CONFIG_ESP_TASK_WDT_EN=y
CONFIG_BT_ENABLED=y
CONFIG_BT_NIMBLE_ENABLED=y
CONFIG_OPENTHREAD_ENABLED=y
CONFIG_MQTT_PROTOCOL_311=y
CONFIG_MBEDTLS_CHACHAPOLY_C=y
CONFIG_MBEDTLS_CHACHA20_C=y
CONFIG_MBEDTLS_POLY1305_C=y
```
